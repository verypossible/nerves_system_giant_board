## Config.in
```kconfig
# Add project-specific packages for Buildroot here

source "$NERVES_DEFCONFIG_DIR/package/extra-dts/Config.in"
source "$NERVES_DEFCONFIG_DIR/package/wilc_firmware/Config.in"
```
